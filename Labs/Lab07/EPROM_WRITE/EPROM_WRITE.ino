#include <EEPROM.h>

float voltage[] = { 8.1038,7.90599008,7.759368319999999,7.60705952,7.4052255999999995,7.239008,7.24741152,7.197253120000001,7.17444128,7.14484544,7.124433600000001,7.0940217599999995,7.12627104,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5.71323808,0.05};
int address = 0;

void clearEEPROM() {
  for (int i = 0; i < EEPROM.length(); i++) {
    EEPROM.write(i, 0);
  }
  Serial.println("EEPROM data successfully deleted");
}

void writeDataToEEPROM() {
  if (EEPROM.put(address, voltage)) {
    Serial.println("EEPROM data successfully written");
  } else {
    Serial.println("Error writing to EEPROM");
  }
}

void setup() {
  Serial.begin(9600);

  // Clear EEPROM before writing new data
  clearEEPROM();

  // Write data to EEPROM
  writeDataToEEPROM();

  float readVoltage[sizeof(voltage) / sizeof(voltage[0])];

  // Read data from EEPROM
  if (EEPROM.get(address, readVoltage)) {
    // Print the read values to the Serial Monitor
    for (int i = 0; i < sizeof(voltage) / sizeof(voltage[0]); i++) {
      Serial.print("Value at index ");
      Serial.print(i);
      Serial.print(": ");
      Serial.println(readVoltage[i], 4); // Adjust the precision as needed
    }

    // Print the size of the readVoltage array
    Serial.print("Size of readVoltage array: ");
    Serial.println(sizeof(readVoltage) / sizeof(readVoltage[0]));
  } else {
    Serial.println("Error reading from EEPROM");
  }
}

void loop() {
  
}
